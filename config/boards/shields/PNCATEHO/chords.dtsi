#include "chord_macros.dtsi"

// переключения языка
TCOMBO_ONLY_BASE_LAYERS(lang_ru, &ht_combo_ru LS(LGUI) 0  , LOT LIT    , ROT RIT,   RU_L  )
TCOMBO_ONLY_BASE_LAYERS(lang_en, &ht_combo_en LS(LGUI) 0  , LOT LIT    , ROT RIT,   ENG_L )

/* Комбо без базового tap поведения (чтобы не конфликтовать с hold-cлоями, tap поведение прописано в слое)
 * - имя, - поведение с cогнутым thumb, - поведение с разогнутым thumb, - с двумя thumb, - клавиши слева, - клавиши справа
*/
//TCOMBO_NO_BASE(b                   , &kp LEFT       , &kp LS(B)        , &kp LS(LEFT)     , TLP             , TRP             )
TCOMBO_NO_BASE_LEFT(b                , &kp LEFT       , &kp LS(B)        , &kp LS(LEFT)     , TLP                               )
TCOMBO_NO_BASE_RIGHT(b               , &kp RIGHT      , &kp LS(B)        , &kp LS(RIGHT)    , TRP                               )

//TCOMBO_NO_BASE(j                   , &kp RIGHT      , &kp LS(J)        , &kp LS(RIGHT)    , TLI             , TRI             )
TCOMBO_NO_BASE_LEFT(j                , &kp RIGHT      , &kp LS(J)        , &kp LS(RIGHT)    , TLI                               )
TCOMBO_NO_BASE_RIGHT(j               , &kp LEFT       , &kp LS(J)        , &kp LS(LEFT)     , TRI                               )


TCOMBO_NO_BASE(h                     , &sk LGUI       , &kp LS(H)        , &kp HOME         , BLP             , BRP             )
TCOMBO_NO_BASE(y                     , &sk LSHIFT     , &kp LS(Y)        , &kp END          , BLI             , BRI             )
TCOMBO_NO_BASE(f                     , &kp UP         , &kp LS(F)        , &kp LS(UP)       , TLR             , TRR             )
TCOMBO_NO_BASE(c                     , &sk LALT       , &kp LS(C)        , &kp PG_UP        , BLR             , BRR             )
TCOMBO_NO_BASE(t                     , &kp DOWN       , &kp LS(T)        , &kp LS(DOWN)     , TLM             , TRM             )

//     name,        press,             curved,          splayed,           both,              chord left,       chord right

// одноклавишные
TCOMBO(n          , &kp N            , &sk LCTRL      , &kp LS(N)        , &kp PG_DN        , BLM             , BRM             )
// двуклавишные
TCOMBO(d          , &kp D            , &kp N1         , &kp LS(D)        , &kp F1           , TLP TLI         , TRP TRI         )
TCOMBO(k          , &kp K            , &kp N2         , &kp LS(K)        , &kp F2           , BLP BLI         , BRP BRI         )
TCOMBO(r          , &kp R            , &kp N3         , &kp LS(R)        , &kp F3           , BLP BLR         , BRP BRR         )
TCOMBO(v          , &kp V            , &kp N4         , &kp LS(V)        , &kp F4           , BLM BLI         , BRM BRI         )
TCOMBO(l          , &kp L            , &kp N5         , &kp LS(L)        , &kp F5           , TLP TLR         , TRP TRR         )
TCOMBO(g          , &kp G            , &kp N6         , &kp LS(G)        , &kp F6           , TLM TLI         , TRM TRI         )
TCOMBO(e          , &kp E            , &kp N7         , &kp LS(E)        , &kp F7           , BLR BLM         , BRR BRM         )
TCOMBO(z          , &kp Z            , &kp N8         , &kp LS(Z)        , &kp F8           , TLR TLM         , TRR TRM         )
TCOMBO(s          , &kp S            , &kp N9         , &kp LS(S)        , &kp F9           , BLP BLM         , BRP BRM         )
TCOMBO(m          , &kp M            , &kp N0         , &kp LS(M)        , &kp F10          , BLR BLI         , BRR BRI         )
TCOMBO(u          , &kp U            , &kp EXCL       , &kp LS(U)        , &kp F11          , TLP TLM         , TRP TRM         )
TCOMBO(p          , &kp P            , &kp AT         , &kp LS(P)        , &kp F12          , TLR TLI         , TRR TRI         )
TCOMBO(comma      , &kp COMMA        , &kp HASH       , &kp LS(COMMA)    , &none            , TLP BLI         , TRP BRI         )
TCOMBO(x          , &kp X            , &kp DLLR       , &kp LS(X)        , &none            , BLP TLI         , BRP TRI         )
TCOMBO(q          , &kp Q            , &kp PRCNT      , &kp LS(Q)        , &none            , TLP BLM         , TRP BRM         )
TCOMBO(lbkt       , &kp LBKT         , &kp CARET      , &kp LS(LBKT)     , &none            , BLR TLI         , BRR TRI         )
TCOMBO(semi       , &kp SEMI         , &kp AMPS       , &kp LS(SEMI)     , &none            , BLP TLM         , BRP TRM         )
TCOMBO(i          , &kp I            , &kp STAR       , &kp LS(I)        , &none            , TLR BLI         , TRR BRI         )
TCOMBO(dot        , &kp DOT          , &kp LPAR       , &kp LS(DOT)      , &none            , TLP BLR         , TRP BRR         )
TCOMBO(w          , &kp W            , &kp RPAR       , &kp LS(W)        , &none            , TLI BLM         , TRI BRM         )
TCOMBO(o          , &kp O            , &kp SLASH      , &kp LS(O)        , &none            , TLR BLM         , TRR BRM         )
TCOMBO(sqt        , &kp SQT          , &kp QMARK      , &kp LS(SQT)      , &none            , TLM BLR         , TRM BRR         )
TCOMBO(a          , &kp A            , &kp MINUS      , &kp LS(A)        , &none            , TLM BLI         , TRM BRI         )
TCOMBO(rbkt       , &kp RBKT         , &kp UNDER      , &kp LS(RBKT)     , &none            , TLR BLP         , TRR BRP         )

// трехклавишные
TCOMBO(grave      , &kp GRAVE        , &kp EQUAL      , &kp LS(GRAVE)    , &none            , BLR BLM BLI     , BRR BRM BRI     )
TCOMBO(nubs       , &kp NUBS         , &kp PLUS       , &kp LS(NUBS)     , &none            , TLR TLM TLI     , TRR TRM TRI     )
TCOMBO(mg_comma   , &mg_comma        , &kp SYM_COLON  , &mg_dot          , &kp SYM_SEMICOL  , TLP TLR TLM     , TRP TRR TRM     )
TCOMBO(minus_dash , &kp SYM_MINUS    , &kp UNDER      , &kp SYM_MATHMIN  , &kp PIPE         , BLP BLR BLM     , BRP BRR BRM     )

// четырехклавишные
TCOMBO(boot       , &none           , &none          , &ext_power EP_OFF, &bootloader      , TLP TLR TLM TLI , TRP TRR TRM TRI )
TCOMBO(bt         , &bt BT_SEL 0    , &bt BT_SEL 1   , &bt BT_SEL 2     , &bt BT_CLR       , BLP BLR BLM BLI , BRP BRR BRM BRI )

TCOMBO_ONLY_BASE_LAYERS(del            , &kp DEL    , TLR BLR , TRR BRR , COMBO_LAYERS )
TCOMBO_ONLY_BASE_LAYERS(esc            , &kp ESC    , TLM BLM , TRM BRM , COMBO_LAYERS )
TCOMBO_ONLY_BASE_LAYERS(tab            , &kp TAB    , TLP BLP , TRP BRP , COMBO_LAYERS )
TCOMBO_ONLY_BASE_LAYERS(enter          , &kp ENTER  , TLI BLI , TRI BRI , COMBO_LAYERS )

// Hold Numbers Layer Combos — двукнопия
TCOMBO_ONLY_BASE_LAYERS(num_8,           &kp N8, TLR TLM, TRR TRM, HOLD_NUM_L)
TCOMBO_ONLY_BASE_LAYERS(num_7,           &kp N7, TLM TLI, TRM TRI, HOLD_NUM_L)
TCOMBO_ONLY_BASE_LAYERS(num_9,           &kp N9, BLM BLI, BRM BRI, HOLD_NUM_L)

// Hold Numbers Layer Combos — комбо с thumb
TCOMBO_NO_BASE_LAYERS(num_2,       &kp SYM_PERCENT, &kp SYM_NUMERO,  &none         , TLM, TRM, HOLD_NUM_L)
TCOMBO_NO_BASE_LAYERS(num_1,       &kp SYM_STAR,    &kp SYM_PLUS,    &none         , TLI, TRI, HOLD_NUM_L)
TCOMBO_NO_BASE_LAYERS(num_5,       &kp SYM_DOLLAR,  &kp SYM_RUBLE,   &none         , BLM, BRM, HOLD_NUM_L)
TCOMBO_NO_BASE_LAYERS(num_4,       &kp SYM_CARET,   &kp SYM_MATHMIN, &kp SYM_DOT   , BLI, BRI, HOLD_NUM_L)

// Hold symbols layer combos
TCOMBO_NO_BASE_LAYERS(sym_at,      &kp SYM_DOLLAR,  &kp SYM_RUBLE,   &kp SYM_AMP,    TLP, TRP, HOLD_SYM_L)

TCOMBO_NO_BASE_LAYERS(sym_lpar,    &kp SYM_LBKT,    &kp SYM_LGUIL,   &kp SYM_LBRACE, TLR, TRM, HOLD_SYM_L)
TCOMBO_NO_BASE_LAYERS(sym_rpar,    &kp SYM_RBKT,    &kp SYM_RGUIL,   &kp SYM_RBRACE, TLM, TRR, HOLD_SYM_L)

TCOMBO_NO_BASE_LAYERS(sym_hash,    &kp SYM_TILDE,   &kp SYM_GRAVE,   &kp SYM_EMPH,   BLP, BRP, HOLD_SYM_L)

TCOMBO_NO_BASE_LEFT_LAYERS(sym_quest,   &kp SYM_EXCL,    &kp SYM_APOS,    &kp SYM_LT,     BLR, HOLD_SYM_L)
TCOMBO_NO_BASE_LEFT_LAYERS(sym_slash,   &kp SYM_BSLH,    &kp SYM_DQUOTE,  &kp SYM_GT,     BLM, HOLD_SYM_L)
TCOMBO_NO_BASE_RIGHT_LAYERS(sym_quest,   &kp SYM_EXCL,    &kp SYM_APOS,    &kp SYM_GT,    BRR, HOLD_SYM_L)
TCOMBO_NO_BASE_RIGHT_LAYERS(sym_slash,   &kp SYM_BSLH,    &kp SYM_DQUOTE,  &kp SYM_LT,    BRM, HOLD_SYM_L)

// Hold navigation layer combos
TCOMBO_NO_BASE_LAYERS(nav_up,      &none,           &kp SYM_UP,    &none, TLM, TRM, HOLD_NAV_L)
TCOMBO_NO_BASE_LAYERS(nav_left,    &none,           &kp SYM_LEFT,  &none, BLR, BRR, HOLD_NAV_L)
TCOMBO_NO_BASE_LAYERS(nav_down,    &none,           &kp SYM_DOWN,  &none, BLM, BRM, HOLD_NAV_L)
TCOMBO_NO_BASE_LAYERS(nav_right,   &none,           &kp SYM_RIGHT, &none, BLI, BRI, HOLD_NAV_L)

TCOMBO_ONLY_BASE_LAYERS(hb_dquote,       &kp SYM_DQUOTE, TLM TLI, TRM TRI, HOLD_BRACKETS_L)
TCOMBO_ONLY_BASE_LAYERS(hb_apos,         &kp SYM_APOS,   BLM BLI, BRM BRI, HOLD_BRACKETS_L)
TCOMBO_ONLY_BASE_LAYERS(hb_pipe,         &kp PIPE,       LIT LOT, RIT ROT, HOLD_BRACKETS_L)

TCOMBO_ONLY_BASE_LAYERS(ht_dot_a,         &kp SYM_DOT_A,    TLM TLI, TRM TRI, HOLD_TYPO_L)
TCOMBO_ONLY_BASE_LAYERS(ht_comma_a,       &kp SYM_COMMA_A,  BLM BLI, BRM BRI, HOLD_TYPO_L)

TCOMBO_ONLY_BASE_LAYERS_IDLE(lock_nav,   &tog NAV_L,   TLM BLR BLI, TRM BRR BRI, RU_L ENG_L NAV_L MOUSE_L, 150)
TCOMBO_ONLY_BASE_LAYERS_IDLE(lock_mouse, &tog MOUSE_L, TLR BLM TLI, TRR BRM TRI, RU_L ENG_L NAV_L MOUSE_L, 150)

TCOMBO_ONLY_BASE_LAYERS(hm_shot_screen,  &kp LG(LS(N4)), TLR TLM, TRR TRM, HOLD_MEDIA_L)
TCOMBO_ONLY_BASE_LAYERS(hm_joxi,         &kp LG(LS(N6)), BLR BLM, BRR BRM, HOLD_MEDIA_L)
